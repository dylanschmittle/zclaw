## main/Kconfig.projbuild
```kconfig
menu "zclaw Configuration"

    config ZCLAW_WIFI_SSID
        string "WiFi SSID (for testing only)"
        default ""
        help
            WiFi network name fallback. Leave empty to use NVS provisioning.
            Recommended: run ./scripts/provision.sh after flashing.

    config ZCLAW_WIFI_PASSWORD
        string "WiFi Password (for testing only)"
        default ""
        help
            WiFi network password fallback. Leave empty to use NVS provisioning.

    config ZCLAW_CLAUDE_API_KEY
        string "LLM API Key (for testing only)"
        default ""
        help
            Anthropic API key fallback. Leave empty to use NVS provisioning.

    config ZCLAW_STUB_LLM
        bool "Stub LLM responses (for QEMU testing)"
        default n
        help
            When enabled, returns hardcoded responses instead of calling the LLM API.
            Useful for testing without WiFi (QEMU emulator).

    config ZCLAW_STUB_TELEGRAM
        bool "Stub Telegram (for QEMU testing)"
        default n
        help
            When enabled, skips Telegram initialization.
            Useful for testing without WiFi.

    config ZCLAW_CHANNEL_UART
        bool "Use UART0 for local channel (QEMU-friendly)"
        default n
        help
            Uses UART0 instead of USB Serial/JTAG for local input/output.
            Enable this for interactive QEMU use.

    config ZCLAW_EMULATOR_MODE
        bool "Offline emulator mode (skip WiFi/NTP/Telegram startup)"
        default n
        help
            Starts only local channel + agent loop, without WiFi-dependent startup.
            Intended for QEMU development workflows.

    config ZCLAW_EMULATOR_LIVE_LLM
        bool "Host-bridged live LLM in emulator mode"
        default n
        help
            Routes LLM requests over UART to a host-side bridge process so QEMU can
            use real provider APIs without guest WiFi/TLS networking.
            Intended for emulator testing only.

    menu "Board Features"
        config ZCLAW_HAS_CAMERA
            bool "Camera support (OV2640)"
            default n
            help
                Enable camera capture via OV2640 sensor.
                Requires a board with a DVP camera interface (e.g., XIAO ESP32-S3 Sense).

        config ZCLAW_HAS_MICROPHONE
            bool "Microphone support (I2S PDM)"
            default n
            help
                Enable audio capture via I2S PDM digital microphone.
                Requires a board with a built-in mic (e.g., XIAO ESP32-S3 Sense).

        config ZCLAW_HAS_PSRAM
            bool "PSRAM available"
            default n
            help
                Board has external PSRAM. Enables larger buffers for camera
                frames, audio data, and LLM payloads.
    endmenu

    menu "Camera Pins (OV2640 DVP)"
        depends on ZCLAW_HAS_CAMERA

        config ZCLAW_CAM_PIN_PWDN
            int "PWDN pin (-1 = not used)"
            range -1 48
            default -1
        config ZCLAW_CAM_PIN_RESET
            int "RESET pin (-1 = not used)"
            range -1 48
            default -1
        config ZCLAW_CAM_PIN_XCLK
            int "XCLK pin"
            range 0 48
            default 10
        config ZCLAW_CAM_PIN_SIOD
            int "SIOD (I2C SDA) pin"
            range 0 48
            default 40
        config ZCLAW_CAM_PIN_SIOC
            int "SIOC (I2C SCL) pin"
            range 0 48
            default 39
        config ZCLAW_CAM_PIN_D7
            int "D7 pin"
            range 0 48
            default 48
        config ZCLAW_CAM_PIN_D6
            int "D6 pin"
            range 0 48
            default 11
        config ZCLAW_CAM_PIN_D5
            int "D5 pin"
            range 0 48
            default 12
        config ZCLAW_CAM_PIN_D4
            int "D4 pin"
            range 0 48
            default 14
        config ZCLAW_CAM_PIN_D3
            int "D3 pin"
            range 0 48
            default 16
        config ZCLAW_CAM_PIN_D2
            int "D2 pin"
            range 0 48
            default 18
        config ZCLAW_CAM_PIN_D1
            int "D1 pin"
            range 0 48
            default 17
        config ZCLAW_CAM_PIN_D0
            int "D0 pin"
            range 0 48
            default 15
        config ZCLAW_CAM_PIN_VSYNC
            int "VSYNC pin"
            range 0 48
            default 38
        config ZCLAW_CAM_PIN_HREF
            int "HREF pin"
            range 0 48
            default 47
        config ZCLAW_CAM_PIN_PCLK
            int "PCLK pin"
            range 0 48
            default 13
    endmenu

    menu "Microphone Pins (I2S PDM)"
        depends on ZCLAW_HAS_MICROPHONE

        config ZCLAW_MIC_PIN_CLK
            int "I2S clock pin"
            range 0 48
            default 42
        config ZCLAW_MIC_PIN_DATA
            int "I2S data pin"
            range 0 48
            default 41
    endmenu

    menu "GPIO Tool Safety"
        config ZCLAW_GPIO_MIN_PIN
            int "Minimum GPIO pin exposed to tools"
            range 0 48
            default 2
            help
                Lower bound for gpio_write/gpio_read tool access.
                Set this to match safe, wired pins on your board.

        config ZCLAW_GPIO_MAX_PIN
            int "Maximum GPIO pin exposed to tools"
            range 0 48
            default 10
            help
                Upper bound for gpio_write/gpio_read tool access.
                Set this to match safe, wired pins on your board.

        config ZCLAW_GPIO_ALLOWED_PINS
            string "Allowed GPIO pins list (optional)"
            default ""
            help
                Optional comma-separated allowlist for gpio_write/gpio_read.
                Example: "1,2,3,4,5,6,7,8,9,43,44"
                When set (non-empty), this list is used instead of min/max range.
    endmenu

endmenu
```
